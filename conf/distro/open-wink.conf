## conf/distro/open-wink.conf
```bitbake
# Copyright (c) 2017 [ A Legge Up ]

MAINTAINER = "Stephen Legge <stephen@aleggeup.com>"

DISTRO = "open-wink"
DISTRO_NAME = "Open Wink"
DISTRO_VERSION ?= "alpha-0.9.0"

SDK_VENDOR = "-openwinksdk"
TARGET_VENDOR = "-openwink"

LOCALCONF_VERSION = "1"
```

## conf/layer.conf
```bitbake
# We have a conf and classes directory, add to BBPATH
BBPATH .= ":${LAYERDIR}"

# We have recipes-* directories, add to BBFILES
BBFILES += "${LAYERDIR}/recipes-*/*/*.bb ${LAYERDIR}/recipes-*/*/*.bbappend"

BBFILE_COLLECTIONS += "open-wink"
BBFILE_PATTERN_open_wink = "^${LAYERDIR}/"
BBFILE_PRIORITY_open_wink = "1"

# This should only be incremented on significant changes that will
# cause compatibility issues with other layers
LAYERVERSION_open_wink = "1"

LAYERDEPENDS_open_wink = "core"

LAYERSERIES_COMPAT_open_wink = "rocko"
```
